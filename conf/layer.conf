## conf/layer.conf
```bitbake
# We have a conf and classes directory, add to BBPATH
BBPATH =. "${LAYERDIR}:"

# We have recipes-* directories, add to BBFILES
BBFILES += "${LAYERDIR}/recipes-*/*/*.bb \
            ${LAYERDIR}/recipes-*/*/*.bbappend"

BBFILE_COLLECTIONS += "renesas-bsp"
BBFILE_PATTERN_renesas-bsp = "^${LAYERDIR}/"
BBFILE_PRIORITY_renesas-bsp = "15"

LAYERSERIES_COMPAT_renesas-bsp = "kirkstone"
#no bb file under meta-openeuler-bsp, set it to 1 to ignore "No bb files" warning
BBFILE_PATTERN_IGNORE_EMPTY_renesas-bsp = "1"
```
